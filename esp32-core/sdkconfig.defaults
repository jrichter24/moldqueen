## esp32-core/sdkconfig.defaults
```kconfig
# Defaults for the Heemol ESP32-S3 N16R8 DevKitC-1 (16 MB flash, 8 MB octal PSRAM).

CONFIG_IDF_TARGET="esp32s3"

# 16 MB flash (the "N16")
CONFIG_ESPTOOLPY_FLASHSIZE_16MB=y
CONFIG_ESPTOOLPY_FLASHSIZE="16MB"

# 8 MB octal PSRAM (the "R8")
CONFIG_SPIRAM=y
CONFIG_SPIRAM_MODE_OCT=y
CONFIG_SPIRAM_SPEED_80M=y

# --- Bluetooth LE / NimBLE -------------------------------------------------
# Use the NimBLE host. LEGACY advertising ONLY (NOT extended): legacy
# ble_gap_adv_set_data updates the adv payload IN PLACE on a running advertiser,
# whereas extended ble_gap_ext_adv_set_data returns EBUSY while active and would
# force a stop/start (the frame-drop runaway). This is the SACRED rule.
CONFIG_BT_ENABLED=y
CONFIG_BT_NIMBLE_ENABLED=y
CONFIG_BT_NIMBLE_EXT_ADV=n

# --- WiFi + WebSocket server ----------------------------------------------
# esp_http_server WebSocket support (the WS API). WiFi + BLE share the one 2.4 GHz
# radio; software coexistence is auto-enabled when both BT and WiFi are on (we do
# NOT pre-tune it — measure first).
CONFIG_HTTPD_WS_SUPPORT=y

# --- Partition table -------------------------------------------------------
# NimBLE + WiFi make the app bigger than the 1 MB single-app default; use a custom
# table with a roomy app partition (we have 16 MB).
CONFIG_PARTITION_TABLE_CUSTOM=y
CONFIG_PARTITION_TABLE_CUSTOM_FILENAME="partitions.csv"
```
